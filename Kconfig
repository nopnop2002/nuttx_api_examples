## Kconfig
```kconfig
menu "Nuttx API Example"
source "HOME/nuttx_api_mq/Kconfig"
source "HOME/nuttx_api_sem/Kconfig"
source "HOME/nuttx_api_syslog/Kconfig"
source "HOME/nuttx_api_task/Kconfig"
source "HOME/nuttx_api_task2/Kconfig"
source "HOME/nuttx_api_task3/Kconfig"
source "HOME/nuttx_api_task4/Kconfig"
source "HOME/nuttx_api_uart/Kconfig"
source "HOME/nuttx_api_wq/Kconfig"
source "HOME/nuttx_file_io/Kconfig"
endmenu # Examples
```

## nuttx_api_mq/Kconfig
```kconfig
#
# For a description of the syntax of this configuration file,
# see the file kconfig-language.txt in the NuttX tools repository.
#

config EXAMPLES_MQ_TEST
	tristate "Named Message Queue Interfaces example"
	default n
	---help---
		Enable the Named Message Queue Interfaces example.

if EXAMPLES_MQ_TEST

config EXAMPLES_MQ_TEST_PROGNAME
	string "Program name"
	default "mq_test"
	---help---
		This is the name of the program that will be use when the NSH ELF
		program is installed.

config EXAMPLES_MQ_TEST_PRIORITY
	int "task priority"
	default 100

config EXAMPLES_MQ_TEST_STACKSIZE
	int "stack size"
	default 2048

endif
```

## nuttx_api_sem/Kconfig
```kconfig
#
# For a description of the syntax of this configuration file,
# see the file kconfig-language.txt in the NuttX tools repository.
#

config EXAMPLES_SEM_TEST
	tristate "Counting Semaphore Interfaces example"
	default n
	---help---
		Enable the Task Create API example

if EXAMPLES_SEM_TEST

config EXAMPLES_SEM_TEST_PROGNAME
	string "Program name"
	default "sem_test"
	depends on BUILD_LOADABLE
	---help---
		This is the name of the program that will be use when the NSH ELF
		program is installed.

config EXAMPLES_SEM_TEST_PRIORITY
	int "task priority"
	default 100

config EXAMPLES_SEM_TEST_STACKSIZE
	int "stack size"
	default 2048

endif
```

## nuttx_api_syslog/Kconfig
```kconfig
#
# For a description of the syntax of this configuration file,
# see the file kconfig-language.txt in the NuttX tools repository.
#

config EXAMPLES_SYSLOG_TEST
	tristate "SYSLOG Interfaces example"
	default n
	---help---
		Enable the Syslog API example

if EXAMPLES_SYSLOG_TEST

config EXAMPLES_SYSLOG_TEST_PROGNAME
	string "Program name"
	default "syslog_test"
	depends on BUILD_LOADABLE
	---help---
		This is the name of the program that will be use when the NSH ELF
		program is installed.

config EXAMPLES_SYSLOG_TEST_PRIORITY
	int "task priority"
	default 100

config EXAMPLES_SYSLOG_TEST_STACKSIZE
	int "stack size"
	default 2048

endif
```

## nuttx_api_task/Kconfig
```kconfig
#
# For a description of the syntax of this configuration file,
# see the file kconfig-language.txt in the NuttX tools repository.
#

config EXAMPLES_TASK_TEST
	tristate "Task Control Interfaces example 1"
	default n
	---help---
		Enable the Task Control Interfaces example.

if EXAMPLES_TASK_TEST

config EXAMPLES_TASK_TEST_PROGNAME
	string "Program name"
	default "task_test"
	---help---
		This is the name of the program that will be use when the NSH ELF
		program is installed.

config EXAMPLES_TASK_TEST_PRIORITY
	int "task priority"
	default 100

config EXAMPLES_TASK_TEST_STACKSIZE
	int "stack size"
	default 2048

endif
```

## nuttx_api_task2/Kconfig
```kconfig
#
# For a description of the syntax of this configuration file,
# see the file kconfig-language.txt in the NuttX tools repository.
#

config EXAMPLES_TASK_TEST2
	tristate "Task Control Interfaces example 2"
	default n
	---help---
		Enable the Task Control Interfaces example.

if EXAMPLES_TASK_TEST2

config EXAMPLES_TASK_TEST2_PROGNAME
	string "Program name"
	default "task_test2"
	---help---
		This is the name of the program that will be use when the NSH ELF
		program is installed.

config EXAMPLES_TASK_TEST2_PRIORITY
	int "task priority"
	default 100

config EXAMPLES_TASK_TEST2_STACKSIZE
	int "stack size"
	default 2048

endif
```

## nuttx_api_task3/Kconfig
```kconfig
#
# For a description of the syntax of this configuration file,
# see the file kconfig-language.txt in the NuttX tools repository.
#

config EXAMPLES_TASK_TEST3
	tristate "Task Scheduling Interfaces example"
	default n
	---help---
		Enable the Task Scheduling Interfaces example.

if EXAMPLES_TASK_TEST3

config EXAMPLES_TASK_TEST3_PROGNAME
	string "Program name"
	default "task_test3"
	---help---
		This is the name of the program that will be use when the NSH ELF
		program is installed.

config EXAMPLES_TASK_TEST3_PRIORITY
	int "task priority"
	default 100

config EXAMPLES_TASK_TEST3_STACKSIZE
	int "stack size"
	default 2048

endif
```

## nuttx_api_task4/Kconfig
```kconfig
#
# For a description of the syntax of this configuration file,
# see the file kconfig-language.txt in the NuttX tools repository.
#

config EXAMPLES_TASK_TEST4
	tristate "Task Synchronization Interfaces example"
	default n
	---help---
		Enable the Task Synchronization Interfaces example.

if EXAMPLES_TASK_TEST4

config EXAMPLES_TASK_TEST4_PROGNAME
	string "Program name"
	default "task_test4"
	---help---
		This is the name of the program that will be use when the NSH ELF
		program is installed.

config EXAMPLES_TASK_TEST4_PRIORITY
	int "task priority"
	default 100

config EXAMPLES_TASK_TEST4_STACKSIZE
	int "stack size"
	default 2048

endif
```

## nuttx_api_uart/Kconfig
```kconfig
#
# For a description of the syntax of this configuration file,
# see the file kconfig-language.txt in the NuttX tools repository.
#

config EXAMPLES_UART_TEST
	tristate "UART Interfaces example"
	default n
	---help---
		Enable the UART Interfaces example.

if EXAMPLES_UART_TEST

config EXAMPLES_UART_TEST_PROGNAME
	string "Program name"
	default "uart_test"
	---help---
		This is the name of the program that will be use when the NSH ELF
		program is installed.

config EXAMPLES_UART_TEST_PRIORITY
	int "task priority"
	default 100

config EXAMPLES_UART_TEST_STACKSIZE
	int "stack size"
	default 2048

endif
```

## nuttx_api_wq/Kconfig
```kconfig
#
# For a description of the syntax of this configuration file,
# see the file kconfig-language.txt in the NuttX tools repository.
#

config EXAMPLES_WQ_TEST
	tristate "Work Queue Interfaces example"
	default n
	---help---
		Enable the Work Queue Interfaces example.

if EXAMPLES_WQ_TEST

config EXAMPLES_WQ_TEST_PROGNAME
	string "Program name"
	default "wq_test"
	---help---
		This is the name of the program that will be use when the NSH ELF
		program is installed.

config EXAMPLES_WQ_TEST_PRIORITY
	int "task priority"
	default 100

config EXAMPLES_WQ_TEST_STACKSIZE
	int "stack size"
	default 2048

endif
```

## nuttx_file_io/Kconfig
```kconfig
#
# For a description of the syntax of this configuration file,
# see the file kconfig-language.txt in the NuttX tools repository.
#

config EXAMPLES_FILE_TEST
	tristate "File IO example"
	default n
	---help---
		Enable the File IO example.

if EXAMPLES_FILE_TEST

config EXAMPLES_FILE_TEST_PROGNAME
	string "Program name"
	default "file_test"
	---help---
		This is the name of the program that will be use when the NSH ELF
		program is installed.

config EXAMPLES_FILE_TEST_PRIORITY
	int "task priority"
	default 100

config EXAMPLES_FILE_TEST_STACKSIZE
	int "stack size"
	default 2048

endif
```
